## p4/components/elrs_tx/Kconfig
```kconfig
menu "FPVBox ELRS TX"

config FPV_ELRS_EU_LBT
    bool "EU CE 2.4 GHz regulatory mode (listen before talk, 10 mW)"
    default n

config FPV_ELRS_MAX_POWER_IDX
    int "Highest ELRS power level (0=10 25 50 100 250 500 1000 2000 mW)"
    range 0 4
    default 3
    help
        The LilyGo SX1280 PA module's gain is not published. Keep the default
        (100 mW) until the output was measured; see docs/WIRING.md.

config FPV_ELRS_BIND_PHRASE
    string "Binding phrase (empty: bind with the receiver's bind mode)"
    default ""

endmenu
```

## p4/components/usb_composite/Kconfig
```kconfig
menu "FPVBox USB composite device"

config FPV_USB_VID
    hex "USB vendor ID"
    default 0x1209
    help
        0x1209/0x0001 is the pid.codes test ID for private use. Get your own
        VID/PID before distributing devices.

config FPV_USB_PID
    hex "USB product ID"
    default 0x0001

config FPV_UVC_PAYLOAD_BYTES
    int "UVC payload (bulk transfer) size"
    range 512 32768
    default 16384

config FPV_USB_DWC2_DMA
    int "Use the DWC2 DMA mode (1) or slave mode (0)"
    range 0 1
    default 0

config FPV_USB_TASK_CORE
    int "TinyUSB task core"
    range 0 1
    default 0

endmenu
```

## p4/components/video_pipe/Kconfig
```kconfig
menu "FPVBox video pipeline"

choice FPV_STD
    prompt "Video standard"
    default FPV_STD_AUTO
    config FPV_STD_AUTO
        bool "Automatic (NTSC / PAL from the line count)"
    config FPV_STD_NTSC
        bool "NTSC only"
    config FPV_STD_PAL
        bool "PAL only"
endchoice

config FPV_DECODE_WORKERS
    int "Line decoder tasks (spread over both cores)"
    range 1 4
    default 2

config FPV_TOP_FIELD
    int "Field parity that holds the top line (weave / line interpolation)"
    range 1 2
    default 1

config FPV_JPEG_QUALITY
    int "MJPEG quality"
    range 30 100
    default 85

config FPV_JPEG_INPUT_YVYU
    bool "JPEG encoder takes YVYU (swap U/V before encoding)"
    default y
    help
        The P4 JPEG encoder's YUV422 input is declared as YVYU. Disable if the
        MJPEG stream shows red and blue swapped.

config FPV_H264_GOP
    int "H.264 GOP (frames between IDR frames)"
    range 1 120
    default 30

config FPV_H264_KBPS
    int "H.264 target bitrate (kbit/s)"
    range 500 20000
    default 6000

endmenu
```

## p4/components/vrx_capture/Kconfig
```kconfig
menu "FPVBox video capture"

config FPV_CAPTURE_HW_DECIMATE
    bool "Divide the 40 MHz bus clock by two in the PARLIO RX unit"
    default y
    help
        C5VRX sends every sample twice on a 40 MHz clock. With this option the
        RX unit samples every second clock edge (20 MB/s into memory). If the
        divided external clock misbehaves on hardware, disable it: the unit
        then captures 40 MB/s and the decoder keeps every second byte.

config FPV_CAPTURE_RING_NODES
    int "Capture ring size in 4032-byte DMA nodes"
    range 4 64
    default 16

endmenu
```
